## meta-custom/conf/layer.conf
```bitbake
# We have a conf and classes directory, add to BBPATH 
BBPATH := "${BBPATH}:${LAYERDIR}" 

# We have a packages directory, add to BBFILES 
BBFILES := "${BBFILES} ${LAYERDIR}/recipes-*/*/*.bb \ 
            ${LAYERDIR}/recipes-*/*/*.bbappend" 

LAYERSERIES_COMPAT_meta-custom = "honister"

BBFILE_COLLECTIONS += "meta-custom" 
BBFILE_PATTERN_meta-custom:= "^${LAYERDIR}/" 
BBFILE_PRIORITY_meta-custom:= "6"

LAYERDEPENDS_gpio= "core"
```

## meta-gpio/conf/layer.conf
```bitbake
# We have a conf and classes directory, add to BBPATH 
BBPATH := "${BBPATH}:${LAYERDIR}" 

# We have a packages directory, add to BBFILES 
BBFILES := "${BBFILES} ${LAYERDIR}/recipes-*/*/*.bb \ 
            ${LAYERDIR}/recipes-*/*/*.bbappend" 

LAYERSERIES_COMPAT_meta-gpio = "honister"

BBFILE_COLLECTIONS += "meta-gpio" 
BBFILE_PATTERN_meta-gpio:= "^${LAYERDIR}/" 
BBFILE_PRIORITY_meta-gpio:= "6"

LAYERDEPENDS_gpio= "core"
```

## meta-gui/conf/layer.conf
```bitbake
# We have a conf and classes directory, add to BBPATH
BBPATH .= ":${LAYERDIR}"

# We have recipes-* directories, add to BBFILES
BBFILES += "${LAYERDIR}/recipes-*/*/*.bb \
            ${LAYERDIR}/recipes-*/*/*.bbappend"

BBFILE_COLLECTIONS += "meta-gui"
BBFILE_PATTERN_meta-gui = "^${LAYERDIR}/"
BBFILE_PRIORITY_meta-gui = "6"

LAYERDEPENDS_meta-gui = "core"
LAYERSERIES_COMPAT_meta-gui = "honister"
```

## meta-temperature/conf/layer.conf
```bitbake
# We have a conf and classes directory, add to BBPATH
BBPATH .= ":${LAYERDIR}"

# We have recipes-* directories, add to BBFILES
BBFILES += "${LAYERDIR}/recipes-*/*/*.bb \
            ${LAYERDIR}/recipes-*/*/*.bbappend"

BBFILE_COLLECTIONS += "meta-temperature"
BBFILE_PATTERN_meta-temperature = "^${LAYERDIR}/"
BBFILE_PRIORITY_meta-temperature = "6"

LAYERDEPENDS_meta-temperature = "core"
LAYERSERIES_COMPAT_meta-temperature = "honister"
```
